## conf/layer.conf
```bitbake
# We have a conf and classes directory, add to BBPATH
BBPATH .= ":${LAYERDIR}"

# We have a packages directory, add to BBFILES
BBFILES += "${LAYERDIR}/recipes-*/*/*.bb"
BBFILES += "${LAYERDIR}/recipes-*/*/*.bbappend"

BBFILE_COLLECTIONS += "snickerdoodle"
BBFILE_PATTERN_snickerdoodle = "^${LAYERDIR}/"
BBFILE_PRIORITY_snickerdoodle = "5"

LAYERDEPENDS_snickerdoodle = "core"
```

## conf/machine/snickerdoodle-black.conf
```bitbake
#@TYPE: Machine
#@NAME: snickerdoodle-black
#@DESCRIPTION: Machine file for krtkl's Snickerdoodle Black

SOC_VARIANT = "7z"
SOC_FAMILY = "zynq"

require conf/machine/include/tune-zynq.inc
require conf/machine/include/machine-xilinx-overrides.inc
require conf/machine/include/machine-xilinx-default.inc
require conf/machine/include/machine-xilinx-board.inc

UBOOT_MACHINE = "snickerdoodle_black_config"
KBUILD_DEFCONFIG_KMACHINE = "snickerdoodle_defconfig"
SPL_BINARY ?= "spl/boot.bin"

EXTRA_IMAGEDEPENDS += " \
	u-boot-zynq-uenv \
	virtual/boot-bin \
	virtual/bootloader \
	"

MACHINE_EXTRA_RRECOMMENDS_append = " \
	linux-firmware-wl18xx \
	"

SERIAL_CONSOLE = "115200 ttyPS0"

# Default device tree for the machine
# KERNEL_DEVICETREE = "snickerdoodle-black.dtb"

IMAGE_BOOT_FILE += " \
	boot.bin \
	uEnv.txt \
	"
```
